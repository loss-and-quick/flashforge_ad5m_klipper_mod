## build_scripts/buildroot/package/python-apprise/Config.in
```kconfig
config BR2_PACKAGE_PYTHON_APPRISE
	bool "python-apprise"
	help
	  Apprise allows you to send notifications to almost all of
	  the most popular notification services available to us today.
	  https://pypi.org/project/apprise/
```

## build_scripts/buildroot/package/python-coherent-licensed/Config.in
```kconfig
config BR2_PACKAGE_PYTHON_COHERENT_LICENSED
	bool "host python-coherent-licensed"
	help
		License management tooling for Coherent System and skeleton projects

		https://pypi.org/project/coherent.licensed
		
```

## build_scripts/buildroot/package/python-importlib-metadata/Config.in
```kconfig
config BR2_PACKAGE_PYTHON_IMPORTLIB_METADATA
	bool "python-importlib-metadata"
	select BR2_PACKAGE_PYTHON_ZIPP
	select BR2_PACKAGE_HOST_PYTHON_SETUPTOOLS_SCM
	select BR2_PACKAGE_HOST_PYTHON_COHERENT_LICENSED
	help
	  Read metadata from Python packages.

	  https://github.com/python/importlib_metadata
```

## build_scripts/buildroot/package/python-inotify-simple/Config.in
```kconfig
config BR2_PACKAGE_PYTHON_INOTIFY_SIMPLE
	bool "python-inotify-simple"
	depends on BR2_LINUX_KERNEL
	depends on BR2_USE_MMU
	help
	  inotify-simple provides a simple interface to Linux inotify.
	  https://pypi.org/project/inotify_simple/
```

## build_scripts/buildroot/package/python-ldap3/Config.in
```kconfig
config BR2_PACKAGE_PYTHON_LDAP3
	bool "python-ldap3"
	select BR2_PACKAGE_PYTHON_PYASN1
	select BR2_PACKAGE_PYTHON_PYCRYPTODOMEX
	help
	  A strictly RFC 4510 conforming LDAP V3 pure Python client library

	  http://ldap3.readthedocs.io/
```

## build_scripts/buildroot/package/python-libnacl/Config.in
```kconfig
config BR2_PACKAGE_PYTHON_LIBNACL
	bool "python-libnacl"
	select BR2_PACKAGE_LIBSODIUM
	help
	  Python bindings for libsodium based on ctypes.

	  https://libnacl.readthedocs.org/
```

## build_scripts/buildroot/package/python-mido/Config.in
```kconfig
config BR2_PACKAGE_PYTHON_MIDO
	bool "python-mido"
	help
	  Mido is a library for working with MIDI messages and ports.

	  https://github.com/mido/mido
```

## build_scripts/buildroot/package/python-mpv/Config.in
```kconfig
config BR2_PACKAGE_PYTHON_MPV
	bool "python-mpv"
    select BR2_PACKAGE_MPV
	help
	  A python interface to the mpv media player

	  https://github.com/jaseg/python-mpv
```

## build_scripts/buildroot/package/python-msgspec/Config.in
```kconfig
config BR2_PACKAGE_PYTHON_MSGSPEC
	bool "python-msgspec"
	help
	  A fast and friendly binary serialization library for Python.

	  https://pypi.org/project/msgspec/
```

## build_scripts/buildroot/package/python-pre-commit/Config.in
```kconfig
config BR2_PACKAGE_PYTHON_PRE_COMMIT
	bool "python-pre-commit"
	select BR2_PACKAGE_GIT
	help
	  pre-commit is a framework for managing and maintaining multi-language
	  pre-commit hooks. Installs version 4.2.0 from PyPI.
	  
	  https://pypi.org/project/pre-commit/
```

## build_scripts/buildroot/package/python-preprocess-cancellation/Config.in
```kconfig
config BR2_PACKAGE_PYTHON_PREPROCESS_CANCELLATION
	bool "python-preprocess-cancellation"
	help
	  preprocess-cancellation is a library for cancelable preprocessing tasks.
	  
	  https://pypi.org/project/preprocess-cancellation/
```

## build_scripts/buildroot/package/python-pywavelets/Config.in
```kconfig
config BR2_PACKAGE_PYTHON_PYWAVELETS
    bool "python-pywavelets"
    select BR2_PACKAGE_PYTHON_NUMPY
    select BR2_PACKAGE_PYTHON_CYTHON
    help
        PyWavelets, wavelet transform module.

        https://github.com/PyWavelets/pywt
```

## build_scripts/buildroot/package/python-smart-open/Config.in
```kconfig
config BR2_PACKAGE_PYTHON_SMART_OPEN
	bool "python-smart-open"
	help
	  smart-open — Utils for streaming large files (S3, HDFS, GCS, Azure Blob Storage, gzip, bz2...)
	  
	  https://pypi.org/project/smart-open/
```

## build_scripts/buildroot/package/python-streaming-form-data/Config.in
```kconfig
config BR2_PACKAGE_PYTHON_STREAMING_FORM_DATA
	bool "python-streaming-form-data"
	select BR2_PACKAGE_PYTHON_SMART_OPEN
	help
	  streaming-form-data is a library for streaming multipart/form-data parsing.
	  
	  https://pypi.org/project/streaming-form-data/
```

## build_scripts/buildroot/package/python-zipp/Config.in
```kconfig
config BR2_PACKAGE_PYTHON_ZIPP
	bool "python-zipp"
	select BR2_PACKAGE_HOST_PYTHON_COHERENT_LICENSED
	select BR2_PACKAGE_HOST_PYTHON_SETUPTOOLS_SCM
	help
	  Backport of pathlib-compatible object wrapper for zip files.

	  https://github.com/jaraco/zipp
```

## build_scripts/buildroot/package/python-zstandard/Config.in
```kconfig
config BR2_PACKAGE_PYTHON_ZSTANDARD
	bool "python-zstandard"
	select BR2_PACKAGE_PYTHON_SETUPTOOLS_SCM
	select BR2_PACKAGE_PYTHON_CFFI
	help
	  Zstandard bindings for Python.

	  https://github.com/indygreg/python-zstandard
```
