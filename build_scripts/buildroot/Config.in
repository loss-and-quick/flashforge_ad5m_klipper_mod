## build_scripts/buildroot/Config.in
```kconfig
source "$BR2_EXTERNAL_AD5M_PATH/package/python-ff-ad5m-audio/Config.in"
source "$BR2_EXTERNAL_AD5M_PATH/package/python-ff-ad5m-backlight/Config.in"
source "$BR2_EXTERNAL_AD5M_PATH/package/klippain-shaketune/Config.in"
source "$BR2_EXTERNAL_AD5M_PATH/package/klipper/Config.in"
source "$BR2_EXTERNAL_AD5M_PATH/package/moonraker/Config.in"
source "$BR2_EXTERNAL_AD5M_PATH/package/mainsail/Config.in"
source "$BR2_EXTERNAL_AD5M_PATH/package/fluidd/Config.in"
source "$BR2_EXTERNAL_AD5M_PATH/package/klipperscreen/Config.in"
source "$BR2_EXTERNAL_AD5M_PATH/package/guppyscreen/Config.in"
source "$BR2_EXTERNAL_AD5M_PATH/package/moonraker-telegram-bot/Config.in"
source "$BR2_EXTERNAL_AD5M_PATH/package/katapult/Config.in"

config BR2_PACKAGE_AD5M_CPU_OVERCLOCK
	bool "Overclock CPU to 1.2 GHz"
	default y
	help
	  Runs the dual-core Cortex-A7 at 1200 MHz instead of the default 1008 MHz.

config BR2_PACKAGE_AD5M_EMMC_OVERCLOCK
	bool "Overclock eMMC to 150 MHz (HS200 / DDR52)"
	default y
	help
	  Runs the onboard eMMC at high speed (up to 150 MHz HS200 / DDR52)
	  instead of stock conservative 25 MHz clock, significantly speeding up
	  system boot time, file indexing, and I/O performance.
```

## build_scripts/buildroot/board/flashforge/ad5m/configs/uboot-ad5m_defconfig
```kconfig
CONFIG_ARM=y
CONFIG_ARCH_SUNXI=y
CONFIG_MACH_SUN8I_R528=y
CONFIG_DEFAULT_DEVICE_TREE="sun8i-t113s-flashforge-ad5m"
CONFIG_DRAM_CLK=792
CONFIG_SPL=y
CONFIG_DRAM_SUNXI_ODT_EN=0
CONFIG_DRAM_SUNXI_TPR0=0x004a2195
CONFIG_DRAM_SUNXI_TPR11=0x340000
CONFIG_DRAM_SUNXI_TPR12=0x25
CONFIG_DRAM_SUNXI_TPR13=0x34000100
CONFIG_DRAM_ZQ=8092667
CONFIG_SUNXI_MINIMUM_DRAM_MB=128
CONFIG_CONS_INDEX=4
CONFIG_MACH_SUN8I_R528_UART3_ON_PORTG=y
CONFIG_MMC_SUNXI_SLOT_EXTRA=-1
CONFIG_SUPPORT_EMMC_BOOT=y
CONFIG_BOOTDELAY=2
CONFIG_CMD_GPT=y
CONFIG_CMD_MMC=y
CONFIG_CMD_FAT=y
CONFIG_CMD_EXT4=y
CONFIG_DISTRO_DEFAULTS=y
# CONFIG_EFI_LOADER is not set
```

## build_scripts/buildroot/package/helixscreen/Config.in
```kconfig
config BR2_PACKAGE_HELIXSCREEN
	bool "helixscreen"
	depends on BR2_PACKAGE_MOONRAKER
	help
	  HelixScreen touch UI for Klipper.

	  https://github.com/prestonbrown/helixscreen
```
