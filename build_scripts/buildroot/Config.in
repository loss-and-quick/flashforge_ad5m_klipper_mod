## build_scripts/buildroot/Config.in
```kconfig
source "$BR2_EXTERNAL_AD5M_PATH/package/python-mido/Config.in"
source "$BR2_EXTERNAL_AD5M_PATH/package/python-ff-ad5m-audio/Config.in"
source "$BR2_EXTERNAL_AD5M_PATH/package/python-ff-ad5m-backlight/Config.in"
source "$BR2_EXTERNAL_AD5M_PATH/package/python-msgspec/Config.in"
source "$BR2_EXTERNAL_AD5M_PATH/package/python-streaming-form-data/Config.in"
source "$BR2_EXTERNAL_AD5M_PATH/package/python-smart-open/Config.in"
source "$BR2_EXTERNAL_AD5M_PATH/package/python-mpv/Config.in"
source "$BR2_EXTERNAL_AD5M_PATH/package/python-inotify-simple/Config.in"
source "$BR2_EXTERNAL_AD5M_PATH/package/python-preprocess-cancellation/Config.in"
source "$BR2_EXTERNAL_AD5M_PATH/package/python-apprise/Config.in"
source "$BR2_EXTERNAL_AD5M_PATH/package/python-pre-commit/Config.in"
source "$BR2_EXTERNAL_AD5M_PATH/package/python-pywavelets/Config.in"
source "$BR2_EXTERNAL_AD5M_PATH/package/python-zstandard/Config.in"
source "$BR2_EXTERNAL_AD5M_PATH/package/python-libnacl/Config.in"
source "$BR2_EXTERNAL_AD5M_PATH/package/python-coherent-licensed/Config.in"
source "$BR2_EXTERNAL_AD5M_PATH/package/python-importlib-metadata/Config.in"
source "$BR2_EXTERNAL_AD5M_PATH/package/python-zipp/Config.in"
source "$BR2_EXTERNAL_AD5M_PATH/package/python-ldap3/Config.in"
source "$BR2_EXTERNAL_AD5M_PATH/package/klippain-shaketune/Config.in"
source "$BR2_EXTERNAL_AD5M_PATH/package/klipper/Config.in"
source "$BR2_EXTERNAL_AD5M_PATH/package/moonraker/Config.in"
source "$BR2_EXTERNAL_AD5M_PATH/package/mainsail/Config.in"
source "$BR2_EXTERNAL_AD5M_PATH/package/fluidd/Config.in"
source "$BR2_EXTERNAL_AD5M_PATH/package/klipperscreen/Config.in"
source "$BR2_EXTERNAL_AD5M_PATH/package/guppyscreen/Config.in"
source "$BR2_EXTERNAL_AD5M_PATH/package/libdom/Config.in"
source "$BR2_EXTERNAL_AD5M_PATH/package/libhubbub/Config.in"
source "$BR2_EXTERNAL_AD5M_PATH/package/libparserutils/Config.in"
source "$BR2_EXTERNAL_AD5M_PATH/package/libwapcaplet/Config.in"
source "$BR2_EXTERNAL_AD5M_PATH/package/libsvgtiny-pixbuf/Config.in"
```

## build_scripts/buildroot/package/katapult/Config.in
```kconfig
config BR2_PACKAGE_KATAPULT
	bool "katapult"
	select BR2_PACKAGE_PYTHON_SERIAL
	select BR2_PACKAGE_PYTHON_CAN
	help
	  Configurable bootloader for Klipper

	  https://github.com/Arksine/katapult

config BR2_PACKAGE_KATAPULT_CONFIGS
	string "Katapult MCU Configuration Files"
	depends on BR2_PACKAGE_KATAPULT
	help
	  Specify a space-separated list of MCU configuration files for bootloader
	  compilation. Each file must be a valid Katapult configuration file in
	  the .config format.

	  Example: "/path/to/mcu1.config /path/to/mcu2.config"

	  Note: Configuration file names must be unique.

	  If this field is left empty, no bootloader firmware will be generated.
```

## build_scripts/buildroot/package/moonraker-telegram-bot/Config.in
```kconfig
config BR2_PACKAGE_MOONRAKER_TELEGRAM_BOT
	bool "moonraker-telegram-bot"
	depends on BR2_PACKAGE_MOONRAKER
	select BR2_PACKAGE_PYTHON_AIOLIMITER
	select BR2_PACKAGE_PYTHON_ANYIO
	select BR2_PACKAGE_PYTHON_APSCHEDULER
    select BR2_PACKAGE_PYTHON_EMOJI
	select BR2_PACKAGE_PYTHON_HTTPCORE
	select BR2_PACKAGE_PYTHON_HTTPX
	select BR2_PACKAGE_PYTHON_IDNA
	select BR2_PACKAGE_PYTHON_ORJSON
	select BR2_PACKAGE_PYTHON_PILLOW
	select BR2_PACKAGE_PYTHON_TELEGRAM_BOT
	select BR2_PACKAGE_PYTHON_SOCKSIO
	select BR2_PACKAGE_PYTHON_H2
	select BR2_PACKAGE_PYTHON_CACHETOOLS
	select BR2_PACKAGE_PYTHON_TZLOCAL
	select BR2_PACKAGE_PYTHON_UVLOOP
	select BR2_PACKAGE_PYTHON_WEBSOCKETS
	help
	  Telegram bot to interact with Moonraker (Klipper Web API Server)

	  https://github.com/nlef/moonraker-telegram-bot
```
